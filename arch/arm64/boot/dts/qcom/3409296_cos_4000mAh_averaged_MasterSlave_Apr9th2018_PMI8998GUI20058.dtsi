
qcom,3409296_cos_4000mah_averaged_masterslave_apr9th2018 {
	qcom,max-voltage-uv = <4450000>;
	qcom,nom-batt-capacity-uah = <4000000>;
	qcom,fastchg-current-ma = <3000>;
	qcom,batt-id-kohm = <20>;
	qcom,battery-beta = <4050>;
	qcom,fg-cc-cv-threshold-mv = <4440>;
	qcom,battery-type = "3409296_cos_4000mah_averaged_masterslave_apr9th2018";
	qcom,checksum = <0xE4E0>;
	qcom,jeita-fcc-ranges = <0   49   375000
		50 99  1150000
		100 449  3000000
		450 550  1350000>;
	qcom,jeita-fv-ranges = <0   49  4450000
		50 99  4450000
		100 449  4450000
		450 550  4100000>;
	qcom,gui-version = "PMI8998GUI - 2.0.0.58";
	qcom,fg-profile-data = [
		82 1F 95 05
		9F 0A 27 06
		E8 1C D5 01
		FD 0D 71 0A
		8D 17 E5 23
		6E 44 3D 5A
		75 00 00 00
		11 00 00 00
		00 00 EC BA
		3D C4 F9 B2
		1A 00 08 00
		6E DB 24 E4
		B6 06 D6 F3
		54 0C 5C 02
		F1 F4 92 2B
		1F 06 09 20
		27 00 14 00
		3B 20 E6 04
		2A 0B 96 05
		D6 1C CC 02
		54 0C 09 12
		90 18 98 23
		54 44 99 5A
		6E 00 00 00
		0F 00 00 00
		00 00 D1 CC
		47 8B 65 CA
		16 00 00 00
		01 EB 24 E4
		DB F4 8B 00
		B5 F5 AE 0A
		29 FB A5 1B
		B1 33 CC FF
		07 10 00 00
		9B 0F 33 47
		16 00 40 00
		A4 01 0A FA
		FF 00 00 00
		00 00 00 00
		00 00 00 00
		00 00 00 00
		00 00 00 00
		00 00 00 00
		00 00 00 00
		00 00 00 00
		00 00 00 00
		00 00 00 00
		00 00 00 00
		00 00 00 00
		00 00 00 00
		00 00 00 00
		00 00 00 00
		00 00 00 00
		00 00 00 00
		00 00 00 00
		00 00 00 00
	];
};
